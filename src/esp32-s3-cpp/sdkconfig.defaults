## src/esp32-s3-cpp/sdkconfig.defaults
```kconfig
# ESP32-S3 Hardware Configuration
CONFIG_IDF_TARGET="esp32s3"
CONFIG_ESP32S3_DEFAULT_CPU_FREQ_240=y
CONFIG_ESP32S3_DATA_CACHE_64KB=y
CONFIG_ESP32S3_INSTRUCTION_CACHE_32KB=y

# PSRAM Configuration
CONFIG_SPIRAM=y
CONFIG_SPIRAM_MODE_QUAD=y
CONFIG_SPIRAM_TYPE_AUTO=y
CONFIG_SPIRAM_SIZE=-1
CONFIG_SPIRAM_MALLOC_RESERVE_INTERNAL=32768
CONFIG_SPIRAM_SPEED_80M=y

# Power Management
CONFIG_PM_ENABLE=y
CONFIG_PM_DFS_INIT_FREQ_MAX=240
CONFIG_PM_DFS_INIT_FREQ_MIN=10
CONFIG_PM_POWER_DOWN_PERIPHERAL_IN_LIGHT_SLEEP=y

# Compiler & Performance
CONFIG_COMPILER_OPTIMIZATION_PERF=y
CONFIG_COMPILER_CXX_EXCEPTIONS=y

# ESP-DSP & Audio
# esp-dsp uses xtensa instructions on S3 automatically
# Main task stack size for AI/DSP
CONFIG_ESP_MAIN_TASK_STACK_SIZE=16384
```
